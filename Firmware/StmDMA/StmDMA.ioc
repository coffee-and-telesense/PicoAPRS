# file: StmDMA.ioc
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DAC.DAC_OutputBuffer=DAC_OUTPUTBUFFER_ENABLE
DAC.DAC_Trigger=DAC_TRIGGER_T6_TRGO
Dma.DAC_CH1.0.Direction=DMA_MEMORY_TO_PERIPH
Dma.DAC_CH1.0.Instance=DMA1_Channel3
Dma.DAC_CH1.0.MemDataAlignment=DMA_MDATAALIGN_WORD
Dma.DAC_CH1.0.MemInc=DMA_MINC_ENABLE
Dma.DAC_CH1.0.Mode=DMA_CIRCULAR
Dma.DAC_CH1.0.PeriphDataAlignment=DMA_PDATAALIGN_WORD
Dma.DAC_CH1.0.PeriphInc=DMA_PINC_DISABLE
Dma.DAC_CH1.0.Priority=DMA_PRIORITY_LOW
Dma.Request0=DAC_CH1
Mcu.Family=STM32F0
Mcu.Name=STM32F091R(B-C)Tx
Mcu.Package=LQFP64
NVIC.DMA1_Ch2_3_DMA2_Ch1_2_IRQn=true\:0\:0\:false\:false\:true\:false\:true\:true
NVIC.TIM6_DAC_IRQn=true\:0\:0\:false\:false\:true\:true\:true\:true
PA4.Signal=COMP_DAC1_group
ProjectManager.HeapSize=0x200
ProjectManager.StackSize=0x400
ProjectManager.TargetToolchain=STM32CubeIDE
RCC.AHBFreq_Value=48000000
RCC.APB1Freq_Value=48000000
RCC.APB1TimFreq_Value=48000000
RCC.HCLKFreq_Value=48000000
RCC.SYSCLKFreq_VALUE=48000000
RCC.SYSCLKSource=RCC_SYSCLKSOURCE_HSI48
SH.COMP_DAC1_group.0=DAC_OUT1,DAC_OUT1
TIM6.AutoReloadPreload=TIM_AUTORELOAD_PRELOAD_ENABLE
TIM6.Period=1
TIM6.Prescaler=625
TIM6.TIM_MasterOutputTrigger=TIM_TRGO_UPDATE
VP_TIM6_VS_ClockSourceINT.Mode=Enable_Timer
board=custom

// file: Core/Src/main.c
/* USER CODE BEGIN Header */
/**
  ******************************************************************************
  * @file           : main.c
  * @brief          : Main program body
  ******************************************************************************
  * @attention
  *
  * Copyright (c) 2024 STMicroelectronics.
  * All rights reserved.
  *
  * This software is licensed under terms that can be found in the LICENSE file
  * in the root directory of this software component.
  * If no LICENSE file comes with this software, it is provided AS-IS.
  *
  ******************************************************************************
  */
/* USER CODE END Header */
#include "main.h"
#include "dac.h"
#include "dma.h"
#include "tim.h"
#include "gpio.h"

/* USER CODE BEGIN Includes */
#include <math.h>
#include <stdlib.h>
#include <stdint.h>

/* USER CODE END Includes */

/* USER CODE BEGIN PD */
#define BIT_STREAM_LEN 128
#define STEPS 32
#define PERIOD 1200
#define SAMPLE_FREQ (STEPS*PERIOD)
/* USER CODE END PD */

/* USER CODE BEGIN PV */
const uint32_t sine_wave_array[32] = {2047, 1648, 1264, 910, 600,  345,
                   156, 39,  0,  39,  156,  345,
                   600, 910, 1264, 1648, 2048, 2447,
                   2831, 3185, 3495, 3750, 3939, 4056,
                   4095, 4056, 3939, 3750, 3495, 3185,
                   2831, 2447};

int input_1[] = {0,1,0,1,0,1,0,1,0,1,0,1,0,1,0,1,0,1,0,1,0,1,0,1,0,1,0,1,0,1,0,1,0,1,0,1,0,1
			  ,0,1,0,1,0,1,0,1,0,1,0,1,0,1,0,1,0,1,0,1,0,1,0,1,0,1,0,1,0,1,0,1,0,1,0,1,0,1,0,1,0,1,0,1,0,1,0,1,0,1,0,1,0,1,0,1,0,1,0,1,0,1,0,1
			  ,0,1,0,1,0,1,0,1,0,1,0,1,0,1,0,1,0,1,0,1,0,1,0,1,0,1
};

int input[] ={0,1,1,1,1,1,1,0,0,0,0,1,0,1,0,1,0,1,0,1,0,0,0,1,0,1,1,0,0,1,0,1,0,0,0,1,
		0,1,0,1,0,0,0,0,0,0,1,0,0,0,0,0,0,0,1,0,0,0,0,0,0,1,1,1,0,1,1,0,1,0,0,1,0,1,
		1,1,1,0,0,1,0,1,0,0,0,0,0,1,0,0,0,1,0,1,0,1,0,0,0,1,1,0,0,1,0,0,0,0,0,0,1,0,
		1,0,0,0,0,1,1,0,1,1,0,0,0,0,0,0,0,0,0,0,1,1,1,1,0,0,0,1,0,0,1,0,1,0,1,0,0,1,
		1,0,0,0,1,1,0,1,1,0,0,0,1,1,0,1,1,0,1,1,1,1,0,1,1,0,0,0,0,0,0,1,0,0,1,1,1,0,
		1,0,1,0,1,1,1,1,0,1,1,0,0,1,0,0,1,1,1,0,0,0,1,1,0,1,1,0,0,0,1,0,0,1,1,0,1,1,
		1,1,0,0,0,1,0,1,0,0,1,1,0,0,0,1,1,1,1,1,1,0
};
int i = 0;
uint32_t errorValue;
/* USER CODE END PV */

void SystemClock_Config(void);
/* USER CODE BEGIN PFP */
uint32_t* audioCPFSK(int* bitstream, int bitstreamLength, int samplingFreq);

/* USER CODE END PFP */

int main(void)
{

  /* MCU Configuration--------------------------------------------------------*/

  /* Reset of all peripherals, Initializes the Flash interface and the Systick. */
  HAL_Init();

  /* Configure the system clock */
  SystemClock_Config();

  /* Initialize all configured peripherals */
  MX_GPIO_Init();
  MX_DMA_Init();
  MX_DAC_Init();
  MX_TIM6_Init();
  /* USER CODE BEGIN 2 */

  uint32_t* data = audioCPFSK(input, BIT_STREAM_LEN, SAMPLE_FREQ);

  HAL_TIM_Base_Start(&htim6);
  if(HAL_DAC_Start_DMA(&hdac, DAC_CHANNEL_1, (uint32_t*)data, BIT_STREAM_LEN*STEPS, DAC_ALIGN_12B_R)== HAL_OK){
  }
  else {
	  errorValue = HAL_DAC_GetError(&hdac);
  }

  while(1){

	  /* if(input[i] == 0){
		  // Stop the timer
		     HAL_TIM_Base_Stop(&htim6);

		     // Set the new prescaler value
		     __HAL_TIM_SET_PRESCALER(&htim6, 625);

		     // Restart the timer
		     HAL_TIM_Base_Start(&htim6);
	  }
	  else {
		  // Stop the timer
		  		     HAL_TIM_Base_Stop(&htim6);

		  		     // Set the new prescaler value
		  		     __HAL_TIM_SET_PRESCALER(&htim6, 341);

		  		     // Restart the timer
		  		     HAL_TIM_Base_Start(&htim6);
	  }

	  if(i<8){
		  i++;
	  }
	  else{
	  i = 0;
	  }

	HAL_DAC_SetValue(&hdac, DAC_CHANNEL_1, DAC_ALIGN_12B_R, dac_value);
	if (dac_value < 4095) {
	dac_value++;
	} else {
	dac_value=0;
	}
	HAL_Delay(1);
*/

  /* USER CODE END 2 */

  /* Infinite loop */

  }
}

void SystemClock_Config(void)
{
  RCC_OscInitTypeDef RCC_OscInitStruct = {0};
  RCC_ClkInitTypeDef RCC_ClkInitStruct = {0};

  /** Initializes the RCC Oscillators according to the specified parameters
  * in the RCC_OscInitTypeDef structure.
  */
  RCC_OscInitStruct.OscillatorType = RCC_OSCILLATORTYPE_HSI48;
  RCC_OscInitStruct.HSI48State = RCC_HSI48_ON;
  RCC_OscInitStruct.PLL.PLLState = RCC_PLL_NONE;
  if (HAL_RCC_OscConfig(&RCC_OscInitStruct) != HAL_OK)
  {
    Error_Handler();
  }

  /** Initializes the CPU, AHB and APB buses clocks
  */
  RCC_ClkInitStruct.ClockType = RCC_CLOCKTYPE_HCLK|RCC_CLOCKTYPE_SYSCLK
                              |RCC_CLOCKTYPE_PCLK1;
  RCC_ClkInitStruct.SYSCLKSource = RCC_SYSCLKSOURCE_HSI48;
  RCC_ClkInitStruct.AHBCLKDivider = RCC_SYSCLK_DIV1;
  RCC_ClkInitStruct.APB1CLKDivider = RCC_HCLK_DIV1;

  if (HAL_RCC_ClockConfig(&RCC_ClkInitStruct, FLASH_LATENCY_1) != HAL_OK)
  {
    Error_Handler();
  }
}

/* USER CODE BEGIN 4 */
uint32_t* audioCPFSK(int* bitstream, int bitstreamLength, int samplingFreq) {
    int fCenter = 1700;
    int fDelta = 500;
    int bitrate = 1200;
    int steps = samplingFreq / bitrate;
    int totalSamples = bitstreamLength * steps;
    //uint32_t dummy[16384] = {0};

    size_t size = (totalSamples * sizeof(uint32_t));

    uint32_t* result = (uint32_t*)malloc(size);
    // Allocate memory for the output array
    //float* y = (float*)malloc(totalSamples * sizeof(float));

    if(result == NULL){
    	return NULL;
    }

    //Convert bitstream to NRZ format
    for (int i = 0; i < bitstreamLength; i++) {
        bitstream[i] = bitstream[i] * 2 - 1;
    }

    result[0] = 0;
    float m = 0;

    for (int i = 1; i < totalSamples; i++) {
        // Interpolate the bitstream to steps points per bit
        int index = (i + steps - 1) / steps;
        int indexPrev = (i - 1 + steps - 1) / steps;

        // Integration of the bitstream with trapezoidal rule
        m += (bitstream[indexPrev - 1] + bitstream[index - 1]) / 2.0;

        // FM Modulation
        result[i] = (uint32_t)(2047.5*(1+(cos(2 * M_PI * i * (fCenter / (double)samplingFreq) - 2 * M_PI * m * (fDelta / (double)samplingFreq)))));

        //result[i] = ((result[i]+1) * 2047);

    }

    return result;
}
    // Set the output length
   // *outputLength = totalSamples;

void HAL_DAC_ConvCpltCallbackCh1(DAC_HandleTypeDef *hdac) {

	//HAL_DAC_Start_DMA(hdac, DAC_CHANNEL_1, (uint32_t*) sine_wave_array, 32,DAC_ALIGN_12B_R);

}

/* USER CODE END 4 */

void Error_Handler(void)
{
  __disable_irq();
  while (1)
  {
  }
}
